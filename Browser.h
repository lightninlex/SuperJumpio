#if defined(__AVR__)
    #include <avr/pgmspace.h>
#elif defined(__PIC32MX__)
    #define PROGMEM
#elif defined(__arm__)
    #define PROGMEM
#endif

const unsigned short BrowserA[0x400] PROGMEM ={
  0xFFFF, 0xFFFF, 0xFFFF, 0xFFFF, 0xFFFF, 0xFFFF, 0xFFFF, 0xFFFF, 0xFFFF, 0xFFFF, 0xFFFF, 0xFFFF, 0xFFFF, 0xFFFF, 0xFFFF, 0xFFFF,   // 0x0010 (16)
  0xFFFF, 0xFFFF, 0xFFFF, 0xFFFF, 0xFFFF, 0xFFFF, 0xFFFF, 0xFFFF, 0xFFFF, 0xFFFF, 0xFFFF, 0xFFFF, 0xFFFF, 0xFFFF, 0xFFFF, 0xFFFF,   // 0x0020 (32)
  0xFFFF, 0xFFFF, 0xFFFF, 0xFFFF, 0xFFFF, 0xFFFF, 0xFFFF, 0xFFFF, 0xFFFF, 0xFFFF, 0xFFFF, 0xFFFF, 0xFFFF, 0xFFFF, 0xFFFF, 0xFFFF,   // 0x0030 (48)
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  0xFFFF, 0xFFFF, 0xFFFF, 0x0000, 0x0000, 0x0000, 0x0000, 0x0000, 0x0000, 0x0000, 0xFFFF, 0xFFFF, 0xFFFF, 0xFFFF, 0xFFFF, 0xFFFF,   // 0x0400 (1024)
};
const unsigned short BrowserB[0x400] PROGMEM ={
  0xFFFF, 0xFFFF, 0xFFFF, 0xFFFF, 0xFFFF, 0xFFFF, 0xFFFF, 0xFFFF, 0xFFFF, 0xFFFF, 0xFFFF, 0xFFFF, 0xFFFF, 0xFFFF, 0xFFFF, 0xFFFF,   // 0x0010 (16)
  0xFFFF, 0xFFFF, 0xFFFF, 0xFFFF, 0xFFFF, 0xFFFF, 0xFFFF, 0xFFFF, 0xFFFF, 0xFFFF, 0xFFFF, 0xFFFF, 0xFFFF, 0xFFFF, 0xFFFF, 0xFFFF,   // 0x0020 (32)
  0xFFFF, 0xFFFF, 0xFFFF, 0xFFFF, 0xFFFF, 0xFFFF, 0xFFFF, 0xFFFF, 0xFFFF, 0xFFFF, 0xFFFF, 0xFFFF, 0xFFFF, 0xFFFF, 0xFFFF, 0xFFFF,   // 0x0030 (48)
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  0xFFFF, 0xFFFF, 0xFFFF, 0xFFFF, 0x0000, 0x0000, 0x0000, 0x0000, 0x0000, 0x0000, 0x0000, 0xFFFF, 0xFFFF, 0xFFFF, 0xFFFF, 0xFFFF,   // 0x0400 (1024)
};
const unsigned short BrowserDamageA[0x400] PROGMEM ={
  0xFFFF, 0xFFFF, 0xFFFF, 0xFFFF, 0xFFFF, 0xFFFF, 0xFFFF, 0xFFFF, 0xFFFF, 0xFFFF, 0xFFFF, 0xFFFF, 0xFFFF, 0xFFFF, 0xFFFF, 0xFFFF,   // 0x0010 (16)
  0xFFFF, 0xFFFF, 0xFFFF, 0xFFFF, 0xFFFF, 0xFFFF, 0xFFFF, 0xFFFF, 0xFFFF, 0xFFFF, 0xFFFF, 0xFFFF, 0xFFFF, 0xFFFF, 0xFFFF, 0xFFFF,   // 0x0020 (32)
  0xFFFF, 0xFFFF, 0xFFFF, 0xFFFF, 0xFFFF, 0xFFFF, 0xFFFF, 0xFFFF, 0xFFFF, 0xFFFF, 0xFFFF, 0xFFFF, 0xFFFF, 0xFFFF, 0xFFFF, 0xFFFF,   // 0x0030 (48)
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  0xFFFF, 0xFFFF, 0xFFFF, 0xF800, 0xF800, 0xF800, 0xF800, 0xF800, 0xF800, 0xF800, 0xFFFF, 0xFFFF, 0xFFFF, 0xFFFF, 0xFFFF, 0xFFFF,   // 0x0400 (1024)
};
const unsigned short BrowserDamageB[0x400] PROGMEM ={
  0xFFFF, 0xFFFF, 0xFFFF, 0xFFFF, 0xFFFF, 0xFFFF, 0xFFFF, 0xFFFF, 0xFFFF, 0xFFFF, 0xFFFF, 0xFFFF, 0xFFFF, 0xFFFF, 0xFFFF, 0xFFFF,   // 0x0010 (16)
  0xFFFF, 0xFFFF, 0xFFFF, 0xFFFF, 0xFFFF, 0xFFFF, 0xFFFF, 0xFFFF, 0xFFFF, 0xFFFF, 0xFFFF, 0xFFFF, 0xFFFF, 0xFFFF, 0xFFFF, 0xFFFF,   // 0x0020 (32)
  0xFFFF, 0xFFFF, 0xFFFF, 0xFFFF, 0xFFFF, 0xFFFF, 0xFFFF, 0xFFFF, 0xFFFF, 0xFFFF, 0xFFFF, 0xFFFF, 0xFFFF, 0xFFFF, 0xFFFF, 0xFFFF,   // 0x0030 (48)
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  0xFFFF, 0xFFFF, 0xFFFF, 0xFFFF, 0xF800, 0xF800, 0xF800, 0xF800, 0xF800, 0xF800, 0xF800, 0xFFFF, 0xFFFF, 0xFFFF, 0xFFFF, 0xFFFF,   // 0x0400 (1024)
};
const unsigned short BrowserDyingA[0x400] PROGMEM ={
  0xFFFF, 0xFFFF, 0xFFFF, 0xFFFF, 0xFFFF, 0xFFFF, 0xFFFF, 0xFFFF, 0xFFFF, 0xFFFF, 0xFFFF, 0xFFFF, 0xFFFF, 0xFFFF, 0xFFFF, 0xFFFF,   // 0x0010 (16)
  0xFFFF, 0xFFFF, 0xFFFF, 0xFFFF, 0xFFFF, 0xFFFF, 0xFFFF, 0xFFFF, 0xFFFF, 0xFFFF, 0xFFFF, 0xFFFF, 0xFFFF, 0xFFFF, 0xFFFF, 0xFFFF,   // 0x0020 (32)
  0xFFFF, 0xFFFF, 0xFFFF, 0xFFFF, 0xFFFF, 0xFFFF, 0xFFFF, 0xFFFF, 0xFFFF, 0xFFFF, 0xFFFF, 0xFFFF, 0xFFFF, 0xFFFF, 0xFFFF, 0xFFFF,   // 0x0030 (48)
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  0xFFFF, 0xFFFF, 0xFFFF, 0xFFFF, 0xF800, 0xF800, 0xF800, 0xF800, 0xF800, 0xF800, 0xF800, 0xFFFF, 0xFFFF, 0xFFFF, 0xFFFF, 0xFFFF,   // 0x0400 (1024)
};
const unsigned short BrowserDyingB[0x400] PROGMEM ={
  0xFFFF, 0xFFFF, 0xFFFF, 0xFFFF, 0xFFFF, 0xFFFF, 0xFFFF, 0xFFFF, 0xFFFF, 0xFFFF, 0xFFFF, 0xFFFF, 0xFFFF, 0xFFFF, 0xFFFF, 0xFFFF,   // 0x0010 (16)
  0xFFFF, 0xFFFF, 0xFFFF, 0xFFFF, 0xFFFF, 0xFFFF, 0xFFFF, 0xFFFF, 0xFFFF, 0xFFFF, 0xFFFF, 0xFFFF, 0xFFFF, 0xFFFF, 0xFFFF, 0xFFFF,   // 0x0020 (32)
  0xFFFF, 0xFFFF, 0xFFFF, 0xFFFF, 0xFFFF, 0xFFFF, 0xFFFF, 0xFFFF, 0xFFFF, 0xFFFF, 0xFFFF, 0xFFFF, 0xFFFF, 0xFFFF, 0xFFFF, 0xFFFF,   // 0x0030 (48)
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  0xFFFF, 0xFFFF, 0xFFFF, 0xF800, 0xF800, 0xF800, 0xF800, 0xF800, 0xF800, 0xF800, 0xFFFF, 0xFFFF, 0xFFFF, 0xFFFF, 0xFFFF, 0xFFFF,   // 0x0400 (1024)
};
const unsigned short BrowserDyingC[0x400] PROGMEM ={
  0xFFFF, 0xFFFF, 0xFFFF, 0xFFFF, 0xFFFF, 0xFFFF, 0xFFFF, 0xFFFF, 0xFFFF, 0xFFFF, 0xFFFF, 0xFFFF, 0xFFFF, 0xFFFF, 0xFFFF, 0xFFFF,   // 0x0010 (16)
  0xFFFF, 0xFFFF, 0xFFFF, 0xFFFF, 0xFFFF, 0xFFFF, 0xFFFF, 0xFFFF, 0xFFFF, 0xFFFF, 0xFFFF, 0xFFFF, 0xFFFF, 0xFFFF, 0xFFFF, 0xFFFF,   // 0x0020 (32)
  0xFFFF, 0xFFFF, 0xFFFF, 0xFFFF, 0xFFFF, 0xFFFF, 0xFFFF, 0xFFFF, 0xFFFF, 0xFFFF, 0xFFFF, 0xFFFF, 0xFFFF, 0xFFFF, 0xFFFF, 0xFFFF,   // 0x0030 (48)
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  0xFFFF, 0xFFFF, 0xFFFF, 0xFFFF, 0xF800, 0xF800, 0xF800, 0xF800, 0xF800, 0xF800, 0xF800, 0xFFFF, 0xFFFF, 0xFFFF, 0xFFFF, 0xFFFF,   // 0x0400 (1024)
};
const unsigned short BrowserDyingD[0x400] PROGMEM ={
  0xFFFF, 0xFFFF, 0xFFFF, 0xFFFF, 0xFFFF, 0xFFFF, 0xFFFF, 0xFFFF, 0xFFFF, 0xFFFF, 0xFFFF, 0xFFFF, 0xFFFF, 0xFFFF, 0xFFFF, 0xFFFF,   // 0x0010 (16)
  0xFFFF, 0xFFFF, 0xFFFF, 0xFFFF, 0xFFFF, 0xFFFF, 0xFFFF, 0xFFFF, 0xFFFF, 0xFFFF, 0xFFFF, 0xFFFF, 0xFFFF, 0xFFFF, 0xFFFF, 0xFFFF,   // 0x0020 (32)
  0xFFFF, 0xFFFF, 0xFFFF, 0xFFFF, 0xFFFF, 0xFFFF, 0xFFFF, 0xFFFF, 0xFFFF, 0xFFFF, 0xFFFF, 0xFFFF, 0xFFFF, 0xFFFF, 0xFFFF, 0xFFFF,   // 0x0030 (48)
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  0xFFFF, 0xFFFF, 0xFFFF, 0xF800, 0xF800, 0xF800, 0xF800, 0xF800, 0xF800, 0xF800, 0xFFFF, 0xFFFF, 0xFFFF, 0xFFFF, 0xFFFF, 0xFFFF,   // 0x0400 (1024)
};
const unsigned short BrowserFireballA[0x100] PROGMEM ={
  0xFFFF, 0xFFFF, 0xFFFF, 0xFFFF, 0xFFFF, 0xFFFF, 0xFFFF, 0xFFFF, 0x0000, 0x0000, 0x0000, 0x0000, 0xFFFF, 0xFFFF, 0xFFFF, 0xFFFF,   // 0x0010 (16)
  0xFFFF, 0xFFFF, 0xFFFF, 0xFFFF, 0xFFFF, 0xFFFF, 0x0000, 0x0000, 0xF800, 0xF800, 0x0000, 0xFFFF, 0xFFFF, 0xFFFF, 0xFFFF, 0xFFFF,   // 0x0020 (32)
  0xFFFF, 0xFFFF, 0x0000, 0xFFFF, 0xFFFF, 0x0000, 0xF800, 0xF800, 0xF800, 0xF800, 0x0000, 0xFFFF, 0xFFFF, 0xFFFF, 0xFFFF, 0xFFFF,   // 0x0030 (48)
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  0xFFFF, 0xFFFF, 0xFFFF, 0xFFFF, 0x0000, 0x0000, 0x0000, 0x0000, 0x0000, 0x0000, 0x0000, 0xFFFF, 0xFFFF, 0xFFFF, 0xFFFF, 0xFFFF,   // 0x0100 (256)
};
const unsigned short BrowserFireballB[0x100] PROGMEM ={
  0xFFFF, 0xFFFF, 0xFFFF, 0xFFFF, 0xFFFF, 0x0000, 0x0000, 0x0000, 0x0000, 0xFFFF, 0xFFFF, 0xFFFF, 0xFFFF, 0xFFFF, 0xFFFF, 0xFFFF,   // 0x0010 (16)
  0xFFFF, 0xFFFF, 0xFFFF, 0xFFFF, 0xFFFF, 0xFFFF, 0x0000, 0xF800, 0xF800, 0x0000, 0xFFFF, 0xFFFF, 0xFFFF, 0xFFFF, 0xFFFF, 0xFFFF,   // 0x0020 (32)
  0xFFFF, 0xFFFF, 0xFFFF, 0x0000, 0x0000, 0xFFFF, 0xFFFF, 0x0000, 0xF800, 0xF800, 0x0000, 0xFFFF, 0xFFFF, 0xFFFF, 0xFFFF, 0xFFFF,   // 0x0030 (48)
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  0xFFFF, 0xFFFF, 0xFFFF, 0xFFFF, 0x0000, 0x0000, 0x0000, 0x0000, 0x0000, 0x0000, 0x0000, 0xFFFF, 0xFFFF, 0xFFFF, 0xFFFF, 0xFFFF,   // 0x0100 (256)
};
#include <TFT_eSPI.h>
struct BrowserObj {
    TFT_eSprite browsersprite;
    TFT_eSprite browserfireballsprite;
    int xPos;
    int yPos;
    unsigned long prevMillis;
    int movementCounter;
    int movementSpeed;
    const int updateInterval = 66;

    bool usingBrowserASprite;
    bool movingUp;
    float browserSpeedMultiplier = 1.0;
    int minSpeed = 2;
    int maxSpeed = 8;
    int browserHP = 3;
    // Fireball related variables
    int fireballXPos;
    int fireballYPos;
    int fireballMovementSpeed = random(-6, -3);
    bool fireballIsActive = false;
    int screenX = xPos - cameraPosX;

  BrowserObj(TFT_eSPI *tft) : browsersprite(tft), browserfireballsprite(tft), xPos(1216), yPos(192), movingUp(true), movementSpeed(3), movementCounter(0) {
        browsersprite.createSprite(32, 32);
        browsersprite.setSwapBytes(true);
        browsersprite.fillSprite(TFT_WHITE);

        browserfireballsprite.createSprite(16, 16);
        browserfireballsprite.setSwapBytes(true);
        browserfireballsprite.fillSprite(TFT_WHITE);
}
void launchFireball() {
  static unsigned long lastLaunchTime = 0;
  unsigned long currentTime = millis();

  // Check if 333 milliseconds have passed since the last launch
  if (currentTime - lastLaunchTime >= 500) {
    if (jumpio.xPos <= 1200) {
      fireballXPos = xPos;
      fireballYPos = yPos + 16;
      fireballIsActive = true;
      updateFireball();
      
      // Update the last launch time
      lastLaunchTime = currentTime;
    }
  }
}
void updateFireball() {
    fireballXPos += fireballMovementSpeed;

    // Reset fireball if it goes off-screen
    if (fireballXPos < xPos - 2000 || fireballXPos < jumpio.xPos-16) {
        fireballXPos = 50000;
        fireballYPos = 380;
        fireballIsActive = false;
    }

    // AABB collision detection with player character
    int fireballRight = fireballXPos + 16; // Assuming fireball sprite width is 16
    int fireballBottom = fireballYPos + 16; // Assuming fireball sprite height is 16
    int playerRight = jumpio.xPos + 16; // Assuming player sprite width is 16
    int playerBottom = jumpio.yPos + 16; // Assuming player sprite height is 16

    if (fireballRight >= jumpio.xPos && fireballXPos <= playerRight && fireballBottom >= jumpio.yPos && fireballYPos <= playerBottom && jumpio.isDashing == false) {
          jumpio.reset();
          jumpio.resetJumpio();
          flapple.xPos = random(16*5, 16*70);
          fireballIsActive = false;



        } else if (fireballRight >= jumpio.xPos && fireballXPos <= playerRight && fireballBottom >= jumpio.yPos && fireballYPos <= playerBottom && jumpio.isDashing) {
          jumpio.bounce(-2);
            jumpio.score += 1000 * jumpio.dashMultiplier;
            jumpio.dashMultiplier++;
            fireballIsActive = false;
        }
    int screenX = fireballXPos - cameraPosX; // Assuming cameraPosX is accessible globally
    if (screenX >= 0 && screenX < SCREEN_WIDTH) {
        if (fireballXPos % 16 < 8) {
            // If the remainder is less than 8, use FireballA
            browserfireballsprite.pushImage(0, 0, 16, 16, BrowserFireballA);
        } else {
            // Otherwise, use FireballB
            browserfireballsprite.pushImage(0, 0, 16, 16, BrowserFireballB);
        }
        browserfireballsprite.pushSprite(screenX, fireballYPos, TFT_WHITE);
    }
}
void update(int cameraPosX) {
  screenX = xPos - cameraPosX;
  checkCollision(cameraPosX);
    // Vertical movement logic
    if (movingUp) {
        yPos -= static_cast<int>(movementSpeed * browserSpeedMultiplier);
    } else {
        yPos += static_cast<int>(movementSpeed * browserSpeedMultiplier);
    }

    // Invert movement direction if it reaches the top or bottom of its movement range
    if ((yPos <= 96 && movingUp) || (yPos >= 192 && !movingUp)) {
        movingUp = !movingUp;
        movementSpeed = random(minSpeed, maxSpeed);
    }

    // Switch between quacktleA and quacktleB sprites
    if (usingBrowserASprite) {
        browsersprite.pushImage(0, 0, 32, 32, BrowserA);
    } else {
        browsersprite.pushImage(0, 0, 32, 32, BrowserB);
    }


    // Calculate on-screen position and draw the sprite
    int screenX = xPos - cameraPosX;
    if (screenX >= 0 && screenX < SCREEN_WIDTH) {
        browsersprite.pushSprite(screenX, yPos, TFT_WHITE);
    }

    // Update sprite animation
    movementCounter++;
    if (movementCounter >= 9) {
        movementCounter = 0;
        usingBrowserASprite = !usingBrowserASprite;
    }
    if(fireballIsActive == false){
      launchFireball();
    } else {
  updateFireball();
    }
}
void checkCollision(int cameraPosX) {
    const int jumpioSpriteSize = 16;
    const int browserSpriteSize = 32;
    int jumpioScreenX = jumpio.xPos - cameraPosX;
    int jumpioScreenY = jumpio.yPos;

    bool overlapX = (jumpioScreenX < screenX + (browserSpriteSize/2)) && (jumpioScreenX + jumpioSpriteSize > screenX);
    bool overlapY = (jumpioScreenY < yPos + browserSpriteSize) && (jumpioScreenY + jumpioSpriteSize > yPos);

    // Top 33% of Browser sprite
    int browserTopHalfY = yPos + (browserSpriteSize / 2);

    if (overlapX && overlapY) {
        if (jumpio.isDashing && jumpioScreenY < browserTopHalfY) {
            browserDamage();
        } else {
            jumpio.resetJumpio();
            jumpio.reset();
        }
    }
}

void browserDamage() {
        browserHP -= 1;
        pauseJumpioMovement();
        animateDamage();
        resumeJumpioMovement();
        jumpio.xPos = 0;
        movingUp = true;
        jumpio.score += 1000 * jumpio.dashMultiplier;
        if(boxCount > 12){
          resetQuestionMarkBoxesBoss();
        }
    if (browserHP <= 0) {
        pauseJumpioMovement();
        animateDeath();
        resumeJumpioMovement();
        jumpio.score += 5000 * jumpio.dashMultiplier;
        gameWin();
    }
}

void pauseJumpioMovement() {
    jumpio.previousSpeedMultiplier = jumpio.jumpioSpeedMultiplier;
    jumpio.jumpioSpeedMultiplier = 0;
}

void resumeJumpioMovement() {
    jumpio.jumpioSpeedMultiplier = jumpio.previousSpeedMultiplier;
}

void animateDamage() {
    browsersprite.fillSprite(TFT_WHITE);
    browsersprite.pushImage(0, 0, 32, 32, BrowserDamageA);
    browsersprite.pushSprite(screenX, yPos, TFT_WHITE); delay(100);
    browsersprite.fillSprite(TFT_WHITE);
    browsersprite.pushImage(0, 0, 32, 32, BrowserA);
    browsersprite.pushSprite(screenX, yPos, TFT_WHITE); delay(100);
    browsersprite.fillSprite(TFT_WHITE);
    browsersprite.pushImage(0, 0, 32, 32, BrowserDamageB);
    browsersprite.pushSprite(screenX, yPos, TFT_WHITE); delay(100);
    browsersprite.fillSprite(TFT_WHITE);
    browsersprite.pushImage(0, 0, 32, 32, BrowserB);
    browsersprite.pushSprite(screenX, yPos, TFT_WHITE); delay(100);
    browsersprite.fillSprite(TFT_WHITE);
    browsersprite.pushImage(0, 0, 32, 32, BrowserDamageA);
    browsersprite.pushSprite(screenX, yPos, TFT_WHITE); delay(100);
    browsersprite.fillSprite(TFT_WHITE);
    browsersprite.pushImage(0, 0, 32, 32, BrowserA);
    browsersprite.pushSprite(screenX, yPos, TFT_WHITE); delay(100);
    browsersprite.fillSprite(TFT_WHITE);
    browsersprite.pushImage(0, 0, 32, 32, BrowserDamageB);
    browsersprite.pushSprite(screenX, yPos, TFT_WHITE); delay(100);
    browsersprite.fillSprite(TFT_WHITE);
    browsersprite.pushImage(0, 0, 32, 32, BrowserB);
    browsersprite.pushSprite(screenX, yPos, TFT_WHITE); delay(100);
    browsersprite.fillSprite(TFT_WHITE);
    browsersprite.pushImage(0, 0, 32, 32, BrowserDamageA);
    browsersprite.pushSprite(screenX, yPos, TFT_WHITE); delay(100);
    browsersprite.fillSprite(TFT_WHITE);
    browsersprite.pushImage(0, 0, 32, 32, BrowserA);
    browsersprite.pushSprite(screenX, yPos, TFT_WHITE); delay(100);
    browsersprite.fillSprite(TFT_WHITE);
    browsersprite.pushImage(0, 0, 32, 32, BrowserDamageB);
    browsersprite.pushSprite(screenX, yPos, TFT_WHITE); delay(100);
    browsersprite.pushImage(0, 0, 32, 32, BrowserB);
    browsersprite.pushSprite(screenX, yPos, TFT_WHITE); delay(100);
    browsersprite.fillSprite(TFT_WHITE);
    browsersprite.pushImage(0, 0, 32, 32, BrowserDamageA);
    browsersprite.pushSprite(screenX, yPos, TFT_WHITE); delay(100);
    browsersprite.fillSprite(TFT_WHITE);
    browsersprite.pushImage(0, 0, 32, 32, BrowserA);
    browsersprite.pushSprite(screenX, yPos, TFT_WHITE); delay(100);
    browsersprite.fillSprite(TFT_WHITE);
    browsersprite.pushImage(0, 0, 32, 32, BrowserDamageB);
    browsersprite.pushSprite(screenX, yPos, TFT_WHITE); delay(100);
    browsersprite.fillSprite(TFT_WHITE);
    browsersprite.pushImage(0, 0, 32, 32, BrowserB);
    browsersprite.pushSprite(screenX, yPos, TFT_WHITE); delay(100);
    browsersprite.fillSprite(TFT_WHITE);
    browsersprite.pushImage(0, 0, 32, 32, BrowserDamageA);
    browsersprite.pushSprite(screenX, yPos, TFT_WHITE); delay(100);
}

void animateDeath() {
    browsersprite.fillSprite(TFT_WHITE);
    browsersprite.pushImage(0, 0, 32, 32, BrowserDyingA);
    browsersprite.pushSprite(screenX, yPos, TFT_WHITE); delay(100);
    browsersprite.fillSprite(TFT_WHITE);
    browsersprite.pushImage(0, 0, 32, 32, BrowserDamageA);
    browsersprite.pushSprite(screenX, yPos, TFT_WHITE); delay(100);
    browsersprite.fillSprite(TFT_WHITE);
    browsersprite.pushImage(0, 0, 32, 32, BrowserDyingB);
    browsersprite.pushSprite(screenX, yPos, TFT_WHITE); delay(100);
    browsersprite.fillSprite(TFT_WHITE);
    browsersprite.pushImage(0, 0, 32, 32, BrowserDamageB);
    browsersprite.pushSprite(screenX, yPos, TFT_WHITE); delay(100);
    browsersprite.fillSprite(TFT_WHITE);
    browsersprite.pushImage(0, 0, 32, 32, BrowserDyingC);
    browsersprite.pushSprite(screenX, yPos, TFT_WHITE); delay(100);
    browsersprite.fillSprite(TFT_WHITE);
    browsersprite.pushImage(0, 0, 32, 32, BrowserDamageA);
    browsersprite.pushSprite(screenX, yPos, TFT_WHITE); delay(100);
    browsersprite.fillSprite(TFT_WHITE);
    browsersprite.pushImage(0, 0, 32, 32, BrowserDyingD);
    browsersprite.pushSprite(screenX, yPos, TFT_WHITE); delay(100);
    browsersprite.fillSprite(TFT_WHITE);
    browsersprite.pushImage(0, 0, 32, 32, BrowserDamageB);
    browsersprite.pushSprite(screenX, yPos, TFT_WHITE); delay(100);
    browsersprite.fillSprite(TFT_WHITE);
    browsersprite.pushImage(0, 0, 32, 32, BrowserDyingA);
    browsersprite.pushSprite(screenX, yPos, TFT_WHITE); delay(100);
    browsersprite.fillSprite(TFT_WHITE);
    browsersprite.pushImage(0, 0, 32, 32, BrowserDamageA);
    browsersprite.pushSprite(screenX, yPos, TFT_WHITE); delay(100);
    browsersprite.fillSprite(TFT_WHITE);
    browsersprite.pushImage(0, 0, 32, 32, BrowserDyingB);
    browsersprite.pushSprite(screenX, yPos, TFT_WHITE); delay(100);
    browsersprite.fillSprite(TFT_WHITE);
    browsersprite.pushImage(0, 0, 32, 32, BrowserDamageB);
    browsersprite.pushSprite(screenX, yPos, TFT_WHITE); delay(100);
    browsersprite.fillSprite(TFT_WHITE);
    browsersprite.pushImage(0, 0, 32, 32, BrowserDyingC);
    browsersprite.pushSprite(screenX, yPos, TFT_WHITE); delay(100);
    browsersprite.fillSprite(TFT_WHITE);
    browsersprite.pushImage(0, 0, 32, 32, BrowserDamageA);
    browsersprite.pushSprite(screenX, yPos, TFT_WHITE); delay(100);
    browsersprite.fillSprite(TFT_WHITE);
    browsersprite.pushImage(0, 0, 32, 32, BrowserDyingD);
    browsersprite.pushSprite(screenX, yPos, TFT_WHITE); delay(100);
    browsersprite.fillSprite(TFT_WHITE);
    browsersprite.pushImage(0, 0, 32, 32, BrowserDamageB);
    browsersprite.pushSprite(screenX, yPos, TFT_WHITE); delay(100);
    browsersprite.fillSprite(TFT_WHITE);
    browsersprite.pushImage(0, 0, 32, 32, BrowserDyingA);
    browsersprite.pushSprite(screenX, yPos, TFT_WHITE); delay(100);
    browsersprite.fillSprite(TFT_WHITE);
    browsersprite.pushImage(0, 0, 32, 32, BrowserDamageA);
    browsersprite.pushSprite(screenX, yPos, TFT_WHITE); delay(100);
    browsersprite.fillSprite(TFT_WHITE);
    browsersprite.pushImage(0, 0, 32, 32, BrowserDyingB);
    browsersprite.pushSprite(screenX, yPos, TFT_WHITE); delay(100);
    browsersprite.fillSprite(TFT_WHITE);
    browsersprite.pushImage(0, 0, 32, 32, BrowserDamageB);
    browsersprite.pushSprite(screenX, yPos, TFT_WHITE); delay(100);
    browsersprite.fillSprite(TFT_WHITE);
    browsersprite.pushImage(0, 0, 32, 32, BrowserDyingC);
    browsersprite.pushSprite(screenX, yPos, TFT_WHITE); delay(100);
    browsersprite.fillSprite(TFT_WHITE);
    browsersprite.pushImage(0, 0, 32, 32, BrowserDamageA);
    browsersprite.pushSprite(screenX, yPos, TFT_WHITE); delay(100);
    browsersprite.fillSprite(TFT_WHITE);
    browsersprite.pushImage(0, 0, 32, 32, BrowserDyingD);
    browsersprite.pushSprite(screenX, yPos, TFT_WHITE); delay(100);
    browsersprite.fillSprite(TFT_WHITE);
    browsersprite.pushImage(0, 0, 32, 32, BrowserDamageB);
    browsersprite.pushSprite(screenX, yPos, TFT_WHITE); delay(100);
    browsersprite.fillSprite(TFT_WHITE);
}
};