#if defined(__AVR__)
    #include <avr/pgmspace.h>
#elif defined(__PIC32MX__)
    #define PROGMEM
#elif defined(__arm__)
    #define PROGMEM
#endif

const unsigned short QuacktleA[0x100] PROGMEM ={
  0xFFFF, 0xFFFF, 0xFFFF, 0x0000, 0xFFFF, 0xFFFF, 0xFFFF, 0xFFFF, 0xFFFF, 0x0000, 0xFFFF, 0xFFFF, 0xFFFF, 0xFFFF, 0xFFFF, 0xFFFF,   // 0x0010 (16)
  0xFFFF, 0xFFFF, 0x0000, 0x0000, 0x0000, 0x0000, 0x0000, 0x0000, 0x0000, 0x0000, 0x0000, 0xFFFF, 0xFFFF, 0xFFFF, 0xFFFF, 0xFFFF,   // 0x0020 (32)
  0xFFFF, 0xFFFF, 0x0000, 0x0000, 0x07E0, 0x07E0, 0x07E0, 0x07E0, 0x07E0, 0x0000, 0x0000, 0xFFFF, 0xFFFF, 0xFFFF, 0xFFFF, 0xFFFF,   // 0x0030 (48)
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  0xFFFF, 0xFFFF, 0xFFFF, 0xFFFF, 0xFFFF, 0x0000, 0x0000, 0x0000, 0xFFFF, 0x0000, 0x0000, 0x0000, 0xFFFF, 0xFFFF, 0xFFFF, 0xFFFF,   // 0x0100 (256)
};
const unsigned short QuacktleB[0x100] PROGMEM ={
  0xFFFF, 0xFFFF, 0xFFFF, 0x0000, 0xFFFF, 0xFFFF, 0xFFFF, 0xFFFF, 0xFFFF, 0x0000, 0xFFFF, 0xFFFF, 0xFFFF, 0xFFFF, 0xFFFF, 0xFFFF,   // 0x0010 (16)
  0xFFFF, 0xFFFF, 0x0000, 0x0000, 0x0000, 0x0000, 0x0000, 0x0000, 0x0000, 0x0000, 0x0000, 0xFFFF, 0xFFFF, 0xFFFF, 0xFFFF, 0xFFFF,   // 0x0020 (32)
  0xFFFF, 0xFFFF, 0x0000, 0x0000, 0x07E0, 0x07E0, 0x07E0, 0x07E0, 0x07E0, 0x0000, 0x0000, 0xFFFF, 0xFFFF, 0xFFFF, 0xFFFF, 0xFFFF,   // 0x0030 (48)
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  0xFFFF, 0xFFFF, 0xFFFF, 0xFFFF, 0xFFFF, 0x0000, 0x0000, 0x0000, 0xFFFF, 0x0000, 0x0000, 0x0000, 0xFFFF, 0xFFFF, 0xFFFF, 0xFFFF,   // 0x0100 (256)
};
const unsigned short QuacktleSquish[0x100] PROGMEM ={
  0xFFFF, 0xFFFF, 0xFFFF, 0xFFFF, 0xFFFF, 0xFFFF, 0xFFFF, 0xFFFF, 0xFFFF, 0xFFFF, 0xFFFF, 0x52AA, 0xFFFF, 0xFFFF, 0xFFFF, 0xFFFF,   // 0x0010 (16)
  0xFFFF, 0xFFFF, 0xFFFF, 0xFFFF, 0xFFFF, 0xFFFF, 0xFFFF, 0xFFFF, 0xFFFF, 0xFFFF, 0xFFFF, 0x0000, 0x0000, 0x0000, 0xAD55, 0xFFFF,   // 0x0020 (32)
  0xFFFF, 0xFFFF, 0xFFFF, 0xFFFF, 0xFFFF, 0xFFFF, 0xFFFF, 0xFFFF, 0xFFFF, 0xFFFF, 0xFFFF, 0x0000, 0x07E0, 0x07E0, 0xAD55, 0xFFFF,   // 0x0030 (48)
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  0xFFFF, 0xFFFF, 0xFFFF, 0xFFFF, 0xFFFF, 0xFFFF, 0xFFFF, 0xFFFF, 0xFFFF, 0xFFFF, 0xFFFF, 0xFFFF, 0x0000, 0xFFFF, 0x0000, 0xFFFF,   // 0x0100 (256)
};
const unsigned short QuacktleFireballA[0x100] PROGMEM ={
  0xFFFF, 0xFFFF, 0xFFFF, 0xFFFF, 0xFFFF, 0xFFFF, 0xFFFF, 0xFFFF, 0xFFFF, 0xFFFF, 0xFFFF, 0xFFFF, 0xFFFF, 0xFFFF, 0xFFFF, 0xFFFF,   // 0x0010 (16)
  0xFFFF, 0xFFFF, 0xFFFF, 0xFFFF, 0xFFFF, 0xFFFF, 0xFFFF, 0xFFFF, 0xFFFF, 0xFFFF, 0xFFFF, 0xFFFF, 0xFFFF, 0xFFFF, 0xFFFF, 0xFFFF,   // 0x0020 (32)
  0xFFFF, 0xFFFF, 0xFFFF, 0xFFFF, 0xFFFF, 0xFB60, 0xFB60, 0xFB60, 0xFB60, 0xFFFF, 0xFFFF, 0xFFFF, 0xFFFF, 0xFFFF, 0xFFFF, 0xFFFF,   // 0x0030 (48)
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  0xFFFF, 0xFFFF, 0xFFFF, 0xFFFF, 0xFFFF, 0xFFFF, 0xFFFF, 0xFFFF, 0xFFFF, 0xFFFF, 0xFFFF, 0xFFFF, 0xFFFF, 0xFFFF, 0xFFFF, 0xFFFF,   // 0x0100 (256)
};

const unsigned short QuacktleFireballB[0x100] PROGMEM ={
0xFFFF, 0xFFFF, 0xFFFF, 0xFFFF, 0xFFFF, 0xFFFF, 0xFFFF, 0xFFFF, 0xFFFF, 0xFFFF, 0xFFFF, 0xFFFF, 0xFFFF, 0xFFFF, 0xFFFF, 0xFFFF,   // 0x0010 (16)
0xFFFF, 0xFFFF, 0xFFFF, 0xFFFF, 0xFFFF, 0xFFFF, 0xFFFF, 0xFFFF, 0xFFFF, 0xFFFF, 0xFFFF, 0xFFFF, 0xFFFF, 0xFFFF, 0xFFFF, 0xFFFF,   // 0x0020 (32)
0xFFFF, 0xFFFF, 0xFFFF, 0xFFFF, 0xFFFF, 0xBAA1, 0xBAA1, 0xBAA1, 0xBAA1, 0xBAA1, 0xBAA1, 0xFFFF, 0xFFFF, 0xFFFF, 0xFFFF, 0xFFFF,   // 0x0030 (48)
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0xFFFF, 0xFFFF, 0xFFFF, 0xFFFF, 0xFFFF, 0xFFFF, 0xFFFF, 0xFFFF, 0xFFFF, 0xFFFF, 0xFFFF, 0xFFFF, 0xFFFF, 0xFFFF, 0xFFFF, 0xFFFF,   // 0x0100 (256)
};

#include <TFT_eSPI.h>
struct QuacktleObj {
    TFT_eSprite quacktlesprite;
    TFT_eSprite fireballsprite;
    int xPos;
    int yPos;
    unsigned long prevMillis;
    int movementCounter;
    int movementSpeed;
    const int updateInterval = 66;
    bool isSquished;
    unsigned long squishStartTime;
    const unsigned long squishDuration = 66;
    bool usingQuacktleASprite;
    bool movingUp;
    float quacktleSpeedMultiplier = 1.0;
    int minSpeed = 2;
    int maxSpeed = 8;

    // Fireball related variables
    int fireballXPos;
    int fireballYPos;
    int fireballMovementSpeed = random(-6, -3);
    bool fireballIsActive = false;

  QuacktleObj(TFT_eSPI *tft) : quacktlesprite(tft), fireballsprite(tft), xPos(2368), yPos(112), movingUp(true), movementSpeed(3), movementCounter(0) {
        quacktlesprite.createSprite(16, 16);
        quacktlesprite.setSwapBytes(true);
        quacktlesprite.fillSprite(TFT_WHITE);

        fireballsprite.createSprite(16, 16);
        fireballsprite.setSwapBytes(true);
        fireballsprite.fillSprite(TFT_WHITE);
}
void launchFireball() {
  static unsigned long lastLaunchTime = 0;
  unsigned long currentTime = millis();

  // Check if 333 milliseconds have passed since the last launch
  if (currentTime - lastLaunchTime >= 800) {
    if (jumpio.xPos <= 2576) {
      fireballXPos = xPos;
      fireballYPos = yPos;
      fireballIsActive = true;
      updateFireball();
      
      // Update the last launch time
      lastLaunchTime = currentTime;
    }
  }
}
void updateFireball() {
    fireballXPos += fireballMovementSpeed;

    // Reset fireball if it goes off-screen
    if (fireballXPos < xPos - 2000 || fireballXPos < jumpio.xPos-32) {
        fireballXPos = 50000;
        fireballYPos = 380;
        fireballIsActive = false;
    }

    // AABB collision detection with player character
    int fireballRight = fireballXPos + 16; // Assuming fireball sprite width is 16
    int fireballBottom = fireballYPos + 16; // Assuming fireball sprite height is 16
    int playerRight = jumpio.xPos + 16; // Assuming player sprite width is 16
    int playerBottom = jumpio.yPos + 16; // Assuming player sprite height is 16

    if (fireballRight >= jumpio.xPos && fireballXPos <= playerRight && fireballBottom >= jumpio.yPos && fireballYPos <= playerBottom && jumpio.isDashing == false) {
          jumpio.reset();
          jumpio.resetJumpio();
          fireballIsActive = false;



        } else if (fireballRight >= jumpio.xPos && fireballXPos <= playerRight && fireballBottom >= jumpio.yPos && fireballYPos <= playerBottom && jumpio.isDashing) {
          jumpio.bounce(-10.0);
            jumpio.score += 1000 * jumpio.dashMultiplier;
            jumpio.dashMultiplier++;
            fireballIsActive = false;
        }
    int screenX = fireballXPos - cameraPosX; // Assuming cameraPosX is accessible globally
    if (screenX >= 0 && screenX < SCREEN_WIDTH) {
        if (fireballXPos % 16 < 8) {
            // If the remainder is less than 8, use FireballA
            fireballsprite.pushImage(0, 0, 16, 16, QuacktleFireballA);
        } else {
            // Otherwise, use FireballB
            fireballsprite.pushImage(0, 0, 16, 16, QuacktleFireballB);
        }
        fireballsprite.pushSprite(screenX, fireballYPos, TFT_WHITE);
    }
}
void update(int cameraPosX) {
  checkCollision(cameraPosX);
    // Vertical movement logic
    if (movingUp) {
        yPos -= static_cast<int>(movementSpeed * quacktleSpeedMultiplier);
    } else {
        yPos += static_cast<int>(movementSpeed * quacktleSpeedMultiplier);
    }

    // Invert movement direction if it reaches the top or bottom of its movement range
    if ((yPos <= 68 && movingUp) || (yPos >= 100 && !movingUp)) {
        movingUp = !movingUp;
        movementSpeed = random(minSpeed, maxSpeed);
    }

    // Switch between quacktleA and quacktleB sprites
    if (usingQuacktleASprite) {
        quacktlesprite.pushImage(0, 0, 16, 16, QuacktleA);
    } else {
        quacktlesprite.pushImage(0, 0, 16, 16, QuacktleB);
    }

    // Reset quacktle if squished
    if (isSquished && millis() - squishStartTime >= squishDuration) {
        isSquished = false;
        movingUp = false;
        xPos = 50000; // Reset position
        yPos = 300;
    }

    // Calculate on-screen position and draw the sprite
    int screenX = xPos - cameraPosX;
    if (screenX >= 0 && screenX < SCREEN_WIDTH) {
        quacktlesprite.pushSprite(screenX, yPos, TFT_WHITE);
    }

    // Update sprite animation
    movementCounter++;
    if (movementCounter >= 9) {
        movementCounter = 0;
        usingQuacktleASprite = !usingQuacktleASprite;
    }
    if(fireballIsActive == false){
      launchFireball();
    } else {
  updateFireball();
    }
}
void checkCollision(int cameraPosX) {
  const int spriteSize = 16;
  int screenX = xPos - cameraPosX;
  int jumpioScreenX = jumpio.xPos - cameraPosX;
  int jumpioScreenY = jumpio.yPos;
  bool overlapX = (jumpioScreenX < screenX + spriteSize) && (jumpioScreenX + spriteSize > screenX);
  bool overlapY = (jumpioScreenY < yPos + spriteSize) && (jumpioScreenY + spriteSize > yPos);
      if (overlapX && overlapY) {
        if (jumpio.isDashing) {
            quacktleSquish();
        } else {
          jumpio.resetJumpio();
          jumpio.reset();
        }
      }
}
void quacktleSquish() {
    if (!isSquished) {
      isSquished = true;
      jumpio.bounce(-6.0);
      jumpio.hasKey = true;
      movingUp = true;
            squishStartTime = millis();
            quacktlesprite.pushImage(0, 0, 16, 16, QuacktleSquish);
        }
    }
};
